## tools/launcher_bootloader/sdkconfig.defaults
```kconfig
CONFIG_BOOTLOADER_SKIP_VALIDATE_IN_DEEP_SLEEP=n
CONFIG_ESPTOOLPY_FLASHMODE_QIO=y
CONFIG_ESPTOOLPY_FLASHFREQ_80M=y
CONFIG_ESPTOOLPY_FLASHSIZE_8MB=y
```
